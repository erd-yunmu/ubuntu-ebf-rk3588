// SPDX-License-Identifier: (GPL-2.0+ OR MIT)
/*
 * Copyright (c) 2023 Rockchip Electronics Co., Ltd.
 */

/dts-v1/;
#include "rk3576.dtsi"
#include "rk3576-u-boot.dtsi"
#include <dt-bindings/input/input.h>

/ {
	model = "Embedfire LubanCat 3";
	compatible = "embedfire,lubancat-3", "rockchip,rk3576";
};
